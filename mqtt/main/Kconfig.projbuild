## mqtt/main/Kconfig.projbuild
```kconfig
menu "Example Configuration"

config ROUTER_SSID
    string "Router SSID"
        default "my-ssid"
        help
            Router SSID.

config ROUTER_PASSWORD
    string "Router password"
        default "my-password"
        help
            Router password.

config MESH_ID
    string "Mesh ID"
        default "123456"
        help
            Mesh network identification, Nodes with the same mesh ID can
            communicate with each other.

config MESH_PASSWORD
    string "Mesh Password"
    default "MESH_PASSWORD"
    help
        Mesh AP password. Password length must be 8 bits smaller than 64 bits,Set to null to not encrypt

config MQTT_URL
    string "MQTT broker URL"
    default "mqtt://192.168.10.20"
    help
        URL of the broker to connect to

config MQTT_USERNAME
    string "MQTT broker username"
    default "mqtt-user"
    help
        Username of the broker to connect to

config MQTT_PASSWORD
    string "MQTT broker password"
    default "246810"
    help
        Password of the broker to connect to

endmenu
```
